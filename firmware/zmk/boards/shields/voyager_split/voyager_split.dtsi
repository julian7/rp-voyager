#include <zephyr/dt-bindings/gpio/gpio.h>


/ {
	/*
	 * Sample GPIO matrix for Voyager (5 rows x 6 cols per half).
	 * Pins are based on QMK config:
	 *   rows: GP2..GP6, cols: GP7..GP12
	 * Adjust GPIO controller and pin numbers to match your PCB.
	 */
	chosen {
		zmk,kscan = &kscan0;
	};

	kscan0: kscan0 {
		compatible = "zmk,kscan-gpio-matrix";
		diode-direction = <COL2ROW>;

		row-gpios = <&gpio0 2 GPIO_ACTIVE_HIGH>,
		            <&gpio0 3 GPIO_ACTIVE_HIGH>,
		            <&gpio0 4 GPIO_ACTIVE_HIGH>,
		            <&gpio0 5 GPIO_ACTIVE_HIGH>,
		            <&gpio0 6 GPIO_ACTIVE_HIGH>;

		col-gpios = <&gpio0 7 GPIO_ACTIVE_HIGH>,
		            <&gpio0 8 GPIO_ACTIVE_HIGH>,
		            <&gpio0 9 GPIO_ACTIVE_HIGH>,
		            <&gpio0 10 GPIO_ACTIVE_HIGH>,
		            <&gpio0 11 GPIO_ACTIVE_HIGH>,
		            <&gpio0 12 GPIO_ACTIVE_HIGH>;
	};
};
