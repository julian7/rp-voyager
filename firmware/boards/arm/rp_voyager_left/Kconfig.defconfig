## firmware/boards/arm/rp_voyager_left/Kconfig.defconfig
```kconfig
if BOARD_RP_VOYAGER_LEFT

config USB_SELF_POWERED
	default n

endif # BOARD_RP_VOYAGER_LEFT
```

## firmware/boards/arm/rp_voyager_left/Kconfig.rp_voyager_left
```kconfig
config BOARD_RP_VOYAGER_LEFT
	select SOC_RP2350A_M33 if BOARD_RP_VOYAGER_LEFT_RP2350A_M33
```

## firmware/boards/arm/rp_voyager_left/board.yml
```yaml
board:
  name: rp_voyager_left
  full_name: RP Voyager Left
  vendor: rp-voyager
  socs:
  - name: rp2350a
```

## firmware/boards/arm/rp_voyager_right/Kconfig.defconfig
```kconfig
if BOARD_RP_VOYAGER_RIGHT

config USB_SELF_POWERED
	default n

endif # BOARD_RP_VOYAGER_RIGHT
```

## firmware/boards/arm/rp_voyager_right/Kconfig.rp_voyager_right
```kconfig
config BOARD_RP_VOYAGER_RIGHT
	select SOC_RP2350A_M33 if BOARD_RP_VOYAGER_RIGHT_RP2350A_M33
```

## firmware/boards/arm/rp_voyager_right/board.yml
```yaml
board:
  name: rp_voyager_right
  full_name: RP Voyager Right
  vendor: rp-voyager
  socs:
  - name: rp2350a
```

## firmware/zmk/boards/arm/voyager_rp2354a/Kconfig.board
```kconfig
# Sample board definition for Voyager RP2354A
config BOARD_VOYAGER_RP2354A
    bool "Voyager RP2354A"
```

## firmware/zmk/boards/arm/voyager_rp2354a/Kconfig.defconfig
```kconfig
if BOARD_VOYAGER_RP2354A

config ZMK_KEYBOARD
	default y

config USB_DEVICE_STACK
	default y

config SERIAL
	default y

endif
```

## firmware/zmk/boards/arm/voyager_rp2354a/voyager_rp2354a_defconfig
```kconfig
# Sample defconfig for Voyager RP2354A
CONFIG_ZMK_KEYBOARD=y
CONFIG_USB_DEVICE_STACK=y
CONFIG_SERIAL=y
CONFIG_GPIO=y
CONFIG_CONSOLE=y
CONFIG_UART_CONSOLE=n
```
